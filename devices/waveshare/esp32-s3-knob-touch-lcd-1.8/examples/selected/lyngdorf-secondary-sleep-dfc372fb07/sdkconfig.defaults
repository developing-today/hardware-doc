## devices/waveshare/esp32-s3-knob-touch-lcd-1.8/examples/selected/lyngdorf-secondary-sleep-dfc372fb07/sdkconfig.defaults
```kconfig
CONFIG_IDF_TARGET="esp32"
CONFIG_ESP_CONSOLE_UART_DEFAULT=y
CONFIG_BOOTLOADER_LOG_LEVEL_NONE=y
```
